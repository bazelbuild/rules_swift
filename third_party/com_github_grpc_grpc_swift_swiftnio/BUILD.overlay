load("@build_bazel_rules_swift//swift:swift.bzl", "swift_binary", "swift_library")
load("@rules_cc//cc:defs.bzl", "cc_library")

swift_library(
    name = "GRPC",
    srcs = glob([
        "Sources/GRPC/**/*.swift",
    ]),
    visibility = ["//visibility:public"],
    deps = [
        ":CGRPCZlib",
        "@com_github_apple_swift_log//:Logging",
        "@com_github_apple_swift_nio//:NIO",
        "@com_github_apple_swift_nio//:NIOCore",
        "@com_github_apple_swift_nio//:NIOPosix",
        "@com_github_apple_swift_nio_extras//:NIOExtras",
        "@com_github_apple_swift_nio_http2//:NIOHPACK",
        "@com_github_apple_swift_nio_http2//:NIOHTTP2",
        "@com_github_apple_swift_nio_ssl//:NIOSSL",
        "@com_github_apple_swift_nio_transport_services//:NIOTransportServices",
        "@com_github_apple_swift_protobuf//:SwiftProtobuf",
    ],
)

cc_library(
    name = "CGRPCZlib",
    srcs = [
        "Sources/CGRPCZlib/empty.c",
    ],
    hdrs = glob([
        "Sources/CGRPCZlib/include/*.h",
    ]),
    includes = ["Sources/CGRPCZlib/include"],
    tags = ["swift_module=CGRPCZlib"],
)


swift_binary(
    name = "protoc-gen-grpc-swift",
    srcs = glob([
        "Sources/protoc-gen-grpc-swift/*.swift",
    ]),
    visibility = ["//visibility:public"],
    deps = [
        "@com_github_apple_swift_protobuf//:SwiftProtobuf",
        "@com_github_apple_swift_protobuf//:SwiftProtobufPluginLibrary",
    ],
)
